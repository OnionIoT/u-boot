## board/onion/common/Kconfig
```kconfig
config WEB_RECOVERY
    bool "Firmware web recovery support"
    help
        Firmware flashing support via http server is
        setuped on the device.
```

## board/onion/omega2p/Kconfig
```kconfig
if BOARD_ONION_OMEGA2P

config SYS_BOARD
	default "omega2p"

config SYS_VENDOR
	default "onion"

config SYS_CONFIG_NAME
	default "onion-omega2p"

endif
```

## board/onion/omega3/Kconfig
```kconfig
if BOARD_ONION_OMEGA3

config SYS_BOARD
	default "omega3"

config SYS_VENDOR
	default "onion"

config SYS_CONFIG_NAME
	default "onion-omega3"

endif
```

## configs/onion-omega3_defconfig
```kconfig
CONFIG_MIPS=y
CONFIG_ARCH_MTMIPS=y
CONFIG_SOC_MT7628=y
CONFIG_BOARD_ONION_OMEGA3=y
CONFIG_DEFAULT_DEVICE_TREE="onion-omega3"
CONFIG_NR_DRAM_BANKS=1
CONFIG_MIPS_BOOT_FDT=y
CONFIG_LEGACY_IMAGE_FORMAT=y
CONFIG_OF_STDOUT_VIA_ALIAS=y
CONFIG_SYS_LOAD_ADDR=0x81800000
CONFIG_SYS_MIPS_TIMER_FREQ=290000000
CONFIG_SYS_MALLOC_LEN=0x100000
CONFIG_SYS_MALLOC_BOOTPARAMS=y
CONFIG_SYS_RELOC_GD_ENV_ADDR=y
CONFIG_HUSH_PARSER=y
CONFIG_NET_RANDOM_ETHADDR=y
CONFIG_LED=y
CONFIG_LED_BLINK=y
CONFIG_LED_GPIO=y
CONFIG_DM_ETH=y
CONFIG_MT7628_ETH=y
CONFIG_PHY=y
CONFIG_MT7621_SPI=y
CONFIG_LZMA=y
CONFIG_SPI=y
CONFIG_SPI_FLASH_GIGADEVICE=y
CONFIG_SPI_FLASH_MACRONIX=y
CONFIG_SPI_FLASH_SPANSION=y
CONFIG_SPI_FLASH_STMICRO=y
CONFIG_SPI_FLASH_WINBOND=y
CONFIG_SPI_FLASH_MTD=y
CONFIG_TEXT_BASE=0x9c000000
CONFIG_ENV_SIZE=0x4000
CONFIG_ENV_OFFSET=0xC8000
CONFIG_ENV_SECT_SIZE=0x10000
CONFIG_ENV_IS_IN_SPI_FLASH=y
CONFIG_MIPS_CACHE_SETUP=y
CONFIG_MIPS_CACHE_DISABLE=y
CONFIG_FIT=y
CONFIG_FIT_SIGNATURE=y
CONFIG_BOARD_LATE_INIT=y
CONFIG_CMD_MEMINFO=y
CONFIG_CMD_GPIO=y
CONFIG_CMD_MTD=y
CONFIG_CMD_SPI=y
CONFIG_CMD_DHCP=y
CONFIG_CMD_MII=y
CONFIG_CMD_PING=y
CONFIG_CMD_TIME=y
CONFIG_CMD_PART=y
CONFIG_CMD_USB=y
CONFIG_CMD_FS_GENERIC=y
CONFIG_USB=y
CONFIG_DM_USB=y
CONFIG_USB_EHCI_HCD=y
CONFIG_USB_EHCI_GENERIC=y
CONFIG_USB_OHCI_HCD=y
CONFIG_USB_OHCI_GENERIC=y
CONFIG_USB_STORAGE=y
CONFIG_MT76X8_USB_PHY=y
CONFIG_FS_EXT4=y
CONFIG_FS_FAT=y
CONFIG_BLK=y
CONFIG_BAUDRATE=115200
CONFIG_MTD=y
CONFIG_MTDPARTS_DEFAULT="spi0.0:800k(u-boot),64k(u-boot-env),64k(factory);spi0.1:48m(firmware)"
CONFIG_MTDIDS_DEFAULT="nor0=spi0.0,spi-nand0=spi0.1"
CONFIG_DM_MTD=y
CONFIG_DM_SPI=y
CONFIG_MTD_SPI_NAND=y
CONFIG_USE_IPADDR=y
CONFIG_USE_SERVERIP=y
CONFIG_USE_BOOTFILE=y
CONFIG_IPADDR="192.168.8.8"
CONFIG_SERVERIP="192.168.8.100"
CONFIG_BOOTFILE="firmware_sysupgrade.bin"
CONFIG_USE_BOOTCOMMAND=y
CONFIG_BOOTCOMMAND="ubi part firmware && ubi read 0x81800000 kernel && bootm 0x81800000"
CONFIG_USE_BOOTARGS=y
CONFIG_BOOTARGS="console=ttyS0,115200 ubi.mtd=firmware root=/dev/ubiblock0_1 rootfstype=squashfs,ubifs"
CONFIG_MTD_UBI=y
CONFIG_CMD_UBI=y
CONFIG_MIPS_RELOCATION_TABLE_SIZE=0x8300
```

## generated_defconfig
```kconfig
# 1 "./arch/../configs/onion-omega3_defconfig"
# 1 "<built-in>"
# 1 "<command-line>"
# 1 "./arch/../configs/onion-omega3_defconfig"
CONFIG_MIPS=y
CONFIG_ARCH_MTMIPS=y
CONFIG_SOC_MT7628=y
CONFIG_BOARD_ONION_OMEGA3=y
CONFIG_DEFAULT_DEVICE_TREE="onion-omega3"
CONFIG_NR_DRAM_BANKS=1
CONFIG_MIPS_BOOT_FDT=y
CONFIG_LEGACY_IMAGE_FORMAT=y
CONFIG_OF_STDOUT_VIA_ALIAS=y
CONFIG_SYS_LOAD_ADDR=0x81800000
CONFIG_SYS_MIPS_TIMER_FREQ=290000000
CONFIG_SYS_MALLOC_LEN=0x100000
CONFIG_SYS_MALLOC_BOOTPARAMS=y
CONFIG_SYS_RELOC_GD_ENV_ADDR=y
CONFIG_HUSH_PARSER=y
CONFIG_NET_RANDOM_ETHADDR=y
CONFIG_LED=y
CONFIG_LED_BLINK=y
CONFIG_LED_GPIO=y
CONFIG_DM_ETH=y
CONFIG_MT7628_ETH=y
CONFIG_PHY=y
CONFIG_MT7621_SPI=y
CONFIG_LZMA=y
CONFIG_SPI=y
CONFIG_SPI_FLASH_GIGADEVICE=y
CONFIG_SPI_FLASH_MACRONIX=y
CONFIG_SPI_FLASH_SPANSION=y
CONFIG_SPI_FLASH_STMICRO=y
CONFIG_SPI_FLASH_WINBOND=y
CONFIG_SPI_FLASH_MTD=y
CONFIG_TEXT_BASE=0x9c000000
CONFIG_ENV_SIZE=0x4000
CONFIG_ENV_OFFSET=0xA0000
CONFIG_ENV_SECT_SIZE=0x10000
CONFIG_ENV_IS_IN_SPI_FLASH=y
CONFIG_MIPS_CACHE_SETUP=y
CONFIG_MIPS_CACHE_DISABLE=y
# CONFIG_HAS_BOARD_SIZE_LIMIT=y
# CONFIG_BOARD_SIZE_LIMIT=524288
CONFIG_FIT=y
CONFIG_FIT_SIGNATURE=y
CONFIG_BOARD_EARLY_INIT_F=y
CONFIG_CMD_MEMINFO=y
CONFIG_CMD_GPIO=y
CONFIG_CMD_MTD=y
CONFIG_CMD_SPI=y
CONFIG_CMD_DHCP=y
CONFIG_CMD_MII=y
CONFIG_CMD_PING=y
CONFIG_CMD_TIME=y
CONFIG_CMD_PART=y
CONFIG_CMD_USB=y
CONFIG_CMD_FS_GENERIC=y
# CONFIG_SPECIFY_CONSOLE_INDEX=y
# CONFIG_CONS_INDEX=3
CONFIG_USB=y
CONFIG_DM_USB=y
CONFIG_USB_EHCI_HCD=y
CONFIG_USB_EHCI_GENERIC=y
CONFIG_USB_OHCI_HCD=y
CONFIG_USB_OHCI_GENERIC=y
# CONFIG_USB_XHCI_HCD=y
# CONFIG_USB_XHCI_BRCM=y
CONFIG_USB_STORAGE=y
CONFIG_MT76X8_USB_PHY=y
CONFIG_FS_EXT4=y
CONFIG_FS_FAT=y
CONFIG_BLK=y
CONFIG_BAUDRATE=115200
CONFIG_MTD=y
CONFIG_MTDPARTS_DEFAULT="spi0.0:640k(u-boot),64k(u-boot-env),64k(factory);spi0.1:24m(firmware)"
CONFIG_MTDIDS_DEFAULT="nor0=spi0.0,spi-nand0=spi0.1"
CONFIG_DM_MTD=y
CONFIG_DM_SPI=y
CONFIG_MTD_SPI_NAND=y
CONFIG_USE_IPADDR=y
CONFIG_USE_SERVERIP=y
CONFIG_USE_BOOTFILE=y
CONFIG_IPADDR="192.168.8.8"
CONFIG_SERVERIP="192.168.8.100"
CONFIG_BOOTFILE="firmware.bin"
CONFIG_USE_BOOTCOMMAND=y
CONFIG_BOOTCOMMAND="sf probe && mtd read firmware 0x81800000 && bootm 0x81800000"
CONFIG_USE_BOOTARGS=y
CONFIG_BOOTARGS="console=ttyS0,115200 rootfstype=squashfs,jffs2"
```
